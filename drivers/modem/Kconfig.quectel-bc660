## drivers/modem/Kconfig.quectel-bc660
```kconfig
# Quectel BC660 driver options

# Copyright (c) 2020 Analog Life LLC
# SPDX-License-Identifier: Apache-2.0
config MODEM_QUECTEL_BC660
	bool "Quectel modem driver"
	select MODEM_CONTEXT
	select MODEM_CMD_HANDLER
	select MODEM_IFACE_UART
	select MODEM_SOCKET
	select NET_SOCKETS_OFFLOAD
	help
	  Choose this setting to enable quectel BC660 LTE-CatM1/NB-IoT modem
	  driver.

if MODEM_QUECTEL_BC660

config MODEM_QUECTEL_BC660_RX_STACK_SIZE
	int "Stack size for the quectel BC660 modem driver RX thread"
	default 1028
	help
	  This stack is used by the quectel BC660 RX thread.

config MODEM_QUECTEL_BC660_RX_WORKQ_STACK_SIZE
	int "Stack size for the quectel BC660 modem driver work queue"
	default 2048
	help
	  This stack is used by the work queue to pass off net_pkt data
	  to the rest of the network stack, letting the rx thread continue
	  processing data.

config MODEM_QUECTEL_BC660_APN
	string "APN for establishing network connection"
	default "internet"
	help
	  This setting is used to set the APN name for the network connection
	  context.  This value is specific to the network provider and may
	  need to be changed.

config MODEM_QUECTEL_BC660_USERNAME
	string "Username for establishing network connection"
	default ""
	help
	  This setting is used to set the User name for the network connection
	  context.  This value is specific to the network provider and may
	  need to be changed.

config MODEM_QUECTEL_BC660_PASSWORD
	string "Password for establishing network connection"
	default ""
	help
	  This setting is used to set the Password for the network connection
	  context.  This value is specific to the network provider and may
	  need to be changed.

config MODEM_QUECTEL_BC660_UNSOL_RDY
	string "Unsolicited response string expected from the modem"
	default "RDY"
	help
	  This string is used to determine when modem powered and ready
	  to accept AT commands. If this value is not matching the modem
	  response, the init will fail with timeout.

config MODEM_QUECTEL_BC660_INIT_PRIORITY
	int "quectel BC660 driver init priority"
	default 80
	help
	  quectel BC660 device driver initialization priority.
	  Do not mess with it unless you know what you are doing.
	  Note that the priority needs to be lower than the net stack
	  so that it can start before the networking sub-system.

endif
```
